## deploy/main/Kconfig.projbuild
```kconfig
menu "Screw/Washer Detector"

    config MODEL_THRESHOLD
        float "Detection confidence threshold"
        range 0.0 1.0
        default 0.80
        help
            Minimum confidence to show detection result.

    config CAMERA_PIN_D0
        int "Camera D0 GPIO"
        default 4
    config CAMERA_PIN_D1
        int "Camera D1 GPIO"
        default 5
    config CAMERA_PIN_D2
        int "Camera D2 GPIO"
        default 18
    config CAMERA_PIN_D3
        int "Camera D3 GPIO"
        default 19
    config CAMERA_PIN_D4
        int "Camera D4 GPIO"
        default 36
    config CAMERA_PIN_D5
        int "Camera D5 GPIO"
        default 39
    config CAMERA_PIN_D6
        int "Camera D6 GPIO"
        default 34
    config CAMERA_PIN_D7
        int "Camera D7 GPIO"
        default 35
    config CAMERA_PIN_XCLK
        int "Camera XCLK GPIO"
        default 21
    config CAMERA_PIN_PCLK
        int "Camera PCLK GPIO"
        default 11
    config CAMERA_PIN_VSYNC
        int "Camera VSYNC GPIO"
        default 6
    config CAMERA_PIN_HREF
        int "Camera HREF GPIO"
        default 7
    config CAMERA_PIN_SDA
        int "Camera SDA GPIO"
        default 13
    config CAMERA_PIN_SCL
        int "Camera SCL GPIO"
        default 14
    config CAMERA_PIN_PWDN
        int "Camera PWDN GPIO"
        default -1

endmenu
```
